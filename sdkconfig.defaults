## sdkconfig.defaults
```kconfig
# Override some defaults so BT stack is enabled and
# Classic BT is enabled and BT_DRAM_RELEASE is disabled
CONFIG_BT_ENABLED=y
CONFIG_BTDM_CTRL_MODE_BLE_ONLY=n
CONFIG_BTDM_CTRL_MODE_BR_EDR_ONLY=y
CONFIG_BTDM_CTRL_MODE_BTDM=n
CONFIG_BT_BLUEDROID_ENABLED=y
CONFIG_BT_CLASSIC_ENABLED=y
CONFIG_BT_A2DP_ENABLE=y
CONFIG_BT_SPP_ENABLED=n
CONFIG_BT_BLE_ENABLED=n
CONFIG_LV_HOR_RES_MAX=240
CONFIG_LV_VER_RES_MAX=240
CONFIG_LV_COLOR_16_SWAP=y
CONFIG_LV_PREDEFINED_PINS_30=y
CONFIG_LV_TFT_DISPLAY_CONTROLLER_ST7789=y
CONFIG_LV_TFT_DISPLAY_USER_CONTROLLER_ST7789=y
CONFIG_CUSTOM_DISPLAY_BUFFER_SIZE=y
CONFIG_CUSTOM_DISPLAY_BUFFER_BYTES=9600
CONFIG_LV_DISPLAY_USE_DC=n
CONFIG_LV_ENABLE_BACKLIGHT_CONTROL=y
CONFIG_LV_BACKLIGHT_ACTIVE_LVL=y
CONFIG_LV_DISP_PIN_BCKL=2
CONFIG_LV_DISP_PIN_RST=27
```
